## conf/layer.conf
```bitbake
# We have a conf and classes directory, add to BBPATH
BBPATH .= ":${LAYERDIR}"

# We have recipes-* directories, add to BBFILES
BBFILES += "${LAYERDIR}/recipes-*/*/*.bb \
            ${LAYERDIR}/recipes-*/*/*.bbappend"

BBFILE_COLLECTIONS += "meta-maivin"
BBFILE_PATTERN_meta-maivin = "^${LAYERDIR}/"
BBFILE_PRIORITY_meta-maivin = "6"

LAYERDEPENDS_meta-maivin = "core"
LAYERSERIES_COMPAT_meta-maivin = "dunfell"
```
